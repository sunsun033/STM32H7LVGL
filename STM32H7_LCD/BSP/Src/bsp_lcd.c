/**
  ******************************************************************************
  * @file    bsp_lcd.c
  * @brief   LTDC + DMA2D LCD driver.
  *
  *          Panel : 7" 800x480, 40-pin FPC, 18-bit RGB666 (6 data lines per colour)
  *          LTDC  : layer 0, pixel format ARGB8888, frame buffer in SDRAM
  *          Frame buffer layout : 0xAARRGGBB (A=31:24, R=23:16, G=15:8, B=7:0)
  *
  *          IMPORTANT: the LTDC layer pixel format must be ARGB8888
  *          (see MX_LTDC_Init in Core/Src/ltdc.c).  RGB565 leaves the red and
  *          blue channels one bit short on an 18-bit panel, and RGB888
  *          misinterprets the 0xAARRGGBB layout so the red channel reads 0.
  ******************************************************************************
  */
#include "bsp_lcd.h"
#include "dma2d.h"

/* Frame buffer pointer: ARGB8888 -> 4 bytes per pixel */
#define LCD_FB_PTR    ((volatile uint32_t *)LCD_FB_ADDR)

/* Debug log hook, injected by the application (may be NULL) */
void (*g_lcd_log)(const char *msg) = 0;

/* ======================== 8x12 ASCII font (0x20..0x7E) ========================
   One byte per row, 8 rows wide (bit7 = leftmost pixel), 12 rows tall.
   Generated from Consolas 11 px, rendered with GDI+ SingleBitPerPixel.
   Only the printable ASCII range is stored; anything else is drawn as a space. */
#define FONT_W   8U
#define FONT_H   12U

static const uint8_t font8x12[95][FONT_H] =
{
    { 0x00U,0x00U,0x00U,0x00U,0x00U,0x00U,0x00U,0x00U,0x00U,0x00U,0x00U,0x00U },   /* 'space' 0x20 */
    { 0x00U,0x08U,0x08U,0x08U,0x08U,0x08U,0x08U,0x00U,0x08U,0x00U,0x00U,0x00U },   /* '!' 0x21 */
    { 0x00U,0x0AU,0x0AU,0x0AU,0x00U,0x00U,0x00U,0x00U,0x00U,0x00U,0x00U,0x00U },   /* '"' 0x22 */
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    { 0x00U,0x00U,0x00U,0x00U,0x00U,0x3AU,0x2EU,0x00U,0x00U,0x00U,0x00U,0x00U },   /* '~' 0x7E */
};

/* ======================== DMA2D config ======================== */

/* The LTDC layer is ARGB8888, so DMA2D must output ARGB8888 as well.
   Note the naming mismatch between the two peripherals:
       LTDC_PIXEL_FORMAT_ARGB8888  <->  DMA2D_OUTPUT_ARGB8888   (correct pair)
       LTDC_PIXEL_FORMAT_RGB888    <->  DMA2D_OUTPUT_ARGB8888   (NOT DMA2D_OUTPUT_RGB888)
   DMA2D's "RGB888" packs the channels differently, so pairing it with an
   LTDC ARGB8888 layer swaps colour channels.
   Fill operations use Register-to-Memory (R2M) mode.
   CubeMX generates MX_DMA2D_Init() as M2M + ARGB8888, which happens to match,
   but we reconfigure here to be explicit and to force R2M. */
static void lcd_dma2d_config_r2m(void)
{
    hdma2d.Init.Mode         = DMA2D_R2M;
    hdma2d.Init.ColorMode    = DMA2D_OUTPUT_ARGB8888;
    hdma2d.Init.OutputOffset = 0U;
    (void)HAL_DMA2D_Init(&hdma2d);
}

/* ======================== Public API ======================== */

void bsp_lcd_backlight(uint8_t on)
{
    HAL_GPIO_WritePin(LCD_BL_EN_GPIO_Port, LCD_BL_EN_Pin,
                      (on != 0U) ? GPIO_PIN_SET : GPIO_PIN_RESET);
}

/* Prepare the display: DMA2D config + clear to black.
   The backlight is deliberately NOT turned on here.

   Reason: the touch controller's reset pin (PG14 / LCD_TP_RST) is SHARED with
   the panel's reset pin (FPC pin 31 P_RESET).  Initialising the GT911 therefore
   also resets the panel, which blanks the picture for ~20 ms.  If the backlight
   is already on, the user sees the screen flash and redraw.

   Correct start-up order:
       bsp_lcd_init();            <- display ready, backlight still OFF
       ...draw whatever you like...   (invisible so far)
       bsp_gt911_init();          <- panel+touch reset happens here, unseen
       bsp_lcd_backlight(1U);     <- now show everything, no flicker */
void bsp_lcd_init(void)
{
    lcd_dma2d_config_r2m();
    bsp_lcd_clear(LCD_COLOR_BLACK);
}

void bsp_lcd_fill_rect(uint16_t x, uint16_t y, uint16_t w, uint16_t h, lcd_color_t color)
{
    uint32_t dst;

    if ((x >= LCD_WIDTH) || (y >= LCD_HEIGHT) || (w == 0U) || (h == 0U))
    {
        return;
    }
    if (((uint32_t)x + w) > LCD_WIDTH)  { w = (uint16_t)(LCD_WIDTH  - x); }
    if (((uint32_t)y + h) > LCD_HEIGHT) { h = (uint16_t)(LCD_HEIGHT - y); }

    /* Destination = FB base + (y * width + x) * bytes_per_pixel */
    dst = LCD_FB_ADDR + ((((uint32_t)y * LCD_WIDTH) + x) * LCD_BYTES_PER_PIXEL);

    /* OutputOffset = how many pixels to skip after each written line before the
       next one starts.  For a full-width fill it is 0; for a partial fill it MUST
       be (LCD_WIDTH - w).

       IMPORTANT: HAL_DMA2D_Start() does NOT reload the OOR register - only
       HAL_DMA2D_Init() writes it.  So updating hdma2d.Init alone has no effect
       and every partial fill runs its lines together (an 8x8 square comes out
       as a 64-pixel horizontal bar).  Write OOR directly. */
    hdma2d.Init.OutputOffset = (uint32_t)(LCD_WIDTH - w);
    hdma2d.Instance->OOR      = (uint32_t)(LCD_WIDTH - w);

    (void)HAL_DMA2D_Start(&hdma2d, (uint32_t)color, dst, (uint32_t)w, (uint32_t)h);
    (void)HAL_DMA2D_PollForTransfer(&hdma2d, 1000U);
}

void bsp_lcd_clear(lcd_color_t color)
{
    bsp_lcd_fill_rect(0U, 0U, LCD_WIDTH, LCD_HEIGHT, color);
}

void bsp_lcd_draw_pixel(uint16_t x, uint16_t y, lcd_color_t color)
{
    if ((x >= LCD_WIDTH) || (y >= LCD_HEIGHT))
    {
        return;
    }
    LCD_FB_PTR[((uint32_t)y * LCD_WIDTH) + x] = color;
}

void bsp_lcd_draw_hline(uint16_t x, uint16_t y, uint16_t w, lcd_color_t color)
{
    bsp_lcd_fill_rect(x, y, w, 1U, color);
}

void bsp_lcd_draw_vline(uint16_t x, uint16_t y, uint16_t h, lcd_color_t color)
{
    bsp_lcd_fill_rect(x, y, 1U, h, color);
}

void bsp_lcd_draw_rect(uint16_t x, uint16_t y, uint16_t w, uint16_t h, lcd_color_t color)
{
    if ((w < 2U) || (h < 2U))
    {
        return;
    }
    bsp_lcd_draw_hline(x, y, w, color);
    bsp_lcd_draw_hline(x, (uint16_t)(y + h - 1U), w, color);
    bsp_lcd_draw_vline(x, y, h, color);
    bsp_lcd_draw_vline((uint16_t)(x + w - 1U), y, h, color);
}

void bsp_lcd_draw_line(int16_t x0, int16_t y0, int16_t x1, int16_t y1, lcd_color_t color)
{
    /* Bresenham line algorithm */
    int16_t dx = (x1 > x0) ? (int16_t)(x1 - x0) : (int16_t)(x0 - x1);
    int16_t dy = (y1 > y0) ? (int16_t)(y1 - y0) : (int16_t)(y0 - y1);
    int16_t sx = (x0 < x1) ? 1 : -1;
    int16_t sy = (y0 < y1) ? 1 : -1;
    int16_t err = (int16_t)(dx - dy);

    for (;;)
    {
        bsp_lcd_draw_pixel((uint16_t)x0, (uint16_t)y0, color);

        if ((x0 == x1) && (y0 == y1))
        {
            break;
        }

        {
            int16_t e2 = (int16_t)(err * 2);
            if (e2 > -dy) { err = (int16_t)(err - dy); x0 = (int16_t)(x0 + sx); }
            if (e2 <  dx) { err = (int16_t)(err + dx); y0 = (int16_t)(y0 + sy); }
        }
    }
}

void bsp_lcd_set_framebuffer(uint32_t addr)
{
    (void)HAL_LTDC_SetAddress(&hltdc, addr, 0U);
}

void bsp_lcd_test_pattern(void)
{
    static const lcd_color_t bars[8] =
    {
        LCD_COLOR_RED,  LCD_COLOR_GREEN,  LCD_COLOR_BLUE,  LCD_COLOR_WHITE,
        LCD_COLOR_BLACK, LCD_COLOR_YELLOW, LCD_COLOR_CYAN, LCD_COLOR_MAGENTA
    };
    uint16_t bar_w = (uint16_t)(LCD_WIDTH / 8U);
    uint8_t  i;

    for (i = 0U; i < 8U; i++)
    {
        bsp_lcd_fill_rect((uint16_t)(i * bar_w), 0U, bar_w, LCD_HEIGHT, bars[i]);
    }

    /* White border: helps spot offset / scaling issues */
    bsp_lcd_draw_rect(20U, 20U, (uint16_t)(LCD_WIDTH - 40U), (uint16_t)(LCD_HEIGHT - 40U),
                      LCD_COLOR_WHITE);
}

/* ======================== Text rendering ======================== */

void bsp_lcd_draw_char(uint16_t x, uint16_t y, char c, lcd_color_t fg, lcd_color_t bg)
{
    const uint8_t *glyph;
    uint8_t        row;
    uint8_t        col;
    uint8_t        code = (uint8_t)c;

    /* Anything outside printable ASCII is drawn as a space */
    if ((code < 0x20U) || (code > 0x7EU))
    {
        code = 0x20U;
    }
    glyph = font8x12[code - 0x20U];

    for (row = 0U; row < FONT_H; row++)
    {
        for (col = 0U; col < FONT_W; col++)
        {
            lcd_color_t px = ((glyph[row] >> (7U - col)) & 0x01U) ? fg : bg;
            bsp_lcd_draw_pixel((uint16_t)(x + col), (uint16_t)(y + row), px);
        }
    }
}

void bsp_lcd_draw_text(uint16_t x, uint16_t y, const char *s, lcd_color_t fg, lcd_color_t bg)
{
    while (*s != '\0')
    {
        bsp_lcd_draw_char(x, y, *s, fg, bg);
        x = (uint16_t)(x + FONT_W);
        s++;
    }
}

uint16_t bsp_lcd_text_width(const char *s)
{
    uint16_t n = 0U;

    while (*s != '\0') { n++; s++; }
    return (uint16_t)(n * FONT_W);
}

void bsp_lcd_draw_text_uint(uint16_t x, uint16_t y, uint32_t v, uint8_t digits,
                            lcd_color_t fg, lcd_color_t bg)
{
    char    buf[12];
    uint8_t i = digits;

    if (i > 10U) { i = 10U; }
    buf[i] = '\0';
    while (i > 0U)
    {
        i--;
        buf[i] = (char)('0' + (v % 10U));
        v /= 10U;
    }
    bsp_lcd_draw_text(x, y, buf, fg, bg);
}

/* ======================== Frame counter (for FPS) ========================
   The LTDC raises a line interrupt when its line counter reaches the value in
   LIPCR.  Programming line 0 therefore produces exactly one interrupt per
   frame, which is the accurate way to measure the real refresh rate.

   NOTE 1: we deliberately do NOT call HAL_LTDC_IRQHandler() from here.  That
   function disables the line interrupt after the first event
   (__HAL_LTDC_DISABLE_IT(hltdc, LTDC_IT_LI)), so it would count exactly one
   frame and then stop.  This minimal handler only clears the flag and counts,
   leaving the interrupt enabled so it keeps firing every frame.

   NOTE 2: if you ever enable the LTDC global interrupt in CubeMX, CubeMX will
   generate its own LTDC_IRQHandler in stm32h7xx_it.c and the linker will report
   a duplicate symbol - in that case delete the handler below. */
static volatile uint32_t s_lcd_frames = 0U;

void LTDC_IRQHandler(void)
{
    if ((LTDC->ISR & LTDC_ISR_LIF) != 0U)
    {
        LTDC->ICR = LTDC_ICR_CLIF;      /* clear the line interrupt flag */
        s_lcd_frames++;
    }
}

void bsp_lcd_frame_init(void)
{
    s_lcd_frames = 0U;

    HAL_NVIC_SetPriority(LTDC_IRQn, 6U, 0U);
    HAL_NVIC_EnableIRQ(LTDC_IRQn);

    /* Line 0 -> one interrupt per frame */
    (void)HAL_LTDC_ProgramLineEvent(&hltdc, 0U);
}

uint32_t bsp_lcd_frame_count(void)
{
    return s_lcd_frames;
}
